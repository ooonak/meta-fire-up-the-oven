## conf/layer.conf
```bitbake
# We have a conf and classes directory, add to BBPATH
BBPATH .= ":${LAYERDIR}"

# We have recipes-* directories, add to BBFILES
BBFILES += "${LAYERDIR}/recipes-*/*/*.bb \
            ${LAYERDIR}/recipes-*/*/*.bbappend"

BBFILE_COLLECTIONS += "meta-fire-up-the-oven"
BBFILE_PATTERN_meta-fire-up-the-oven = "^${LAYERDIR}/"
BBFILE_PRIORITY_meta-fire-up-the-oven = "6"

LAYERDEPENDS_meta-fire-up-the-oven = "core"
LAYERSERIES_COMPAT_meta-fire-up-the-oven = "mickledore"
```
